## release/images/boot/boot.its
```
/*
 * Copyright (C) 2020 Rockchip Electronics Co., Ltd
 *
 * SPDX-License-Identifier: GPL-2.0
 */

/dts-v1/;
/ {
	description = "FIT source file for Linux";
	#address-cells = <1>;

	images {
		fdt {
			data = /incbin/("./kernel.dtb");
			type = "flat_dt";
			arch = "arm";
			compression = "none";
			load  = <0x00c00000>;
			hash {
				algo = "sha256";
			};
		};

		kernel {
			data = /incbin/("./zImage");
			compression = "none";
			type = "kernel";
			arch = "arm";
			os = "linux";
			entry = <0x00008000>;
			load  = <0x00008000>;
			hash {
				algo = "sha256";
			};
		};

/*
		ramdisk {
			data = /incbin/("./ramdisk");
			compression = "none";
			type = "ramdisk";
			arch = "arm";
			os = "linux";
			entry = <0x0>;
			load  = <0x000e00000>;
			hash {
				algo = "sha256";
			};
		};
*/
		resource {
			data = /incbin/("./resource.img");
			type = "multi";
			arch = "arm";
			compression = "none";
			hash {
				algo = "sha256";
			};
		};
	};

	configurations {
		default = "conf";
		conf {
			description = "Boot Linux kernel with FDT blob";
			rollback-index = <0>;
			fdt = "fdt";
			kernel = "kernel";
			/* ramdisk = "ramdisk"; */
			multi = "resource";
		};
	};
};
```

## sysdrv/source/uboot/u-boot/arch/arm/mach-rockchip/rv1106/Kconfig
```kconfig
if ROCKCHIP_RV1106

config TARGET_EVB_RV1106
	bool "EVB_RV1106"
	help
	  RV1106 EVB is a evaluation board for Rockchp RV1106.

config TARGET_EVB_RV1106_PICO_ULTRA
	bool "EVB_RV1106_PICO_ULTRA"
	help
	  RV1106 EVB PICO ULTRA is a develop board for LuckFox.

config SYS_SOC
	default "rockchip"

config SYS_MALLOC_F_LEN
	default 0x400

source board/rockchip/evb_rv1106/Kconfig
source board/rockchip/evb_rv1106_pico_ultra/Kconfig

endif
```

## sysdrv/source/uboot/u-boot/board/rockchip/evb_rv1106_pico_ultra/Kconfig
```kconfig
if TARGET_EVB_RV1106_PICO_ULTRA

config SYS_BOARD
	default "evb_rv1106_pico_ultra"

config SYS_VENDOR
	default "rockchip"

config SYS_CONFIG_NAME
	default "evb_rv1106_pico_ultra"

config BOARD_SPECIFIC_OPTIONS # dummy
	def_bool y

endif
```

## sysdrv/tools/board/buildroot/luckfox_pico_ultra_custom_defconfig
```kconfig
BR2_arm=y
BR2_cortex_a7=y
BR2_TOOLCHAIN_EXTERNAL=y
BR2_TOOLCHAIN_EXTERNAL_CUSTOM=y
BR2_TOOLCHAIN_EXTERNAL_PATH="../../../../tools/linux/toolchain/arm-rockchip830-linux-uclibcgnueabihf"
BR2_TOOLCHAIN_EXTERNAL_CUSTOM_PREFIX="arm-rockchip830-linux-uclibcgnueabihf"
BR2_TOOLCHAIN_EXTERNAL_GCC_8=y
BR2_TOOLCHAIN_EXTERNAL_HEADERS_5_10=y
BR2_TOOLCHAIN_EXTERNAL_WCHAR=y
BR2_TOOLCHAIN_EXTERNAL_HAS_SSP=y
BR2_TOOLCHAIN_EXTERNAL_CXX=y
BR2_PRIMARY_SITE="https://mirrors.lzu.edu.cn/buildroot"
BR2_OPTIMIZE_3=y
BR2_TARGET_GENERIC_HOSTNAME="luckfox pico ultra"
BR2_TARGET_GENERIC_ISSUE="Welcome to luckfox pico ultra"
BR2_SYSTEM_ENABLE_NLS=y
BR2_PACKAGE_BUSYBOX_CONFIG="package/busybox/busybox-custom.config"
BR2_PACKAGE_BUSYBOX_SHOW_OTHERS=y
BR2_PACKAGE_ALSA_UTILS=y
BR2_PACKAGE_ALSA_UTILS_APLAY=y
BR2_PACKAGE_ALSA_UTILS_SPEAKER_TEST=y
BR2_PACKAGE_E2FSPROGS=y
BR2_PACKAGE_E2FSPROGS_RESIZE2FS=y
BR2_PACKAGE_LIBV4L=y
BR2_PACKAGE_LIBV4L_UTILS=y
# BR2_PACKAGE_IFUPDOWN_SCRIPTS is not set
BR2_PACKAGE_IPERF3=y
BR2_PACKAGE_NTP=y
BR2_PACKAGE_OPENSSH=y
BR2_PACKAGE_WGET=y
BR2_PACKAGE_WIRELESS_TOOLS=y
BR2_PACKAGE_WPA_SUPPLICANT=y
BR2_PACKAGE_WPA_SUPPLICANT_WPA3=y
BR2_PACKAGE_WPA_SUPPLICANT_CLI=y
```
